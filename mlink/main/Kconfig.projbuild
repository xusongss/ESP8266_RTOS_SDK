## mlink/main/Kconfig.projbuild
```kconfig
menu "Example Configuration"
config ESP_WIFI_SSID
    string "WiFi SSID"
    default "myssid"
    help
	SSID (network name) for the example to connect to.

config ESP_WIFI_PASSWORD
    string "WiFi Password"
    default "mypassword"
    help
	WiFi password (WPA or WPA2) for the example to use.
		
config MDNS_HOSTNAME
    string "mDNS Hostname"
	default "esp32-mdns"
	help
		mDNS Hostname for example to use

config MDNS_INSTANCE
    string "mDNS Instance Name"
	default "ESP32 with mDNS"
	help
		mDNS Instance Name for example to use
		
config MESH_DEVICE_TID
	 int "Mesh network device id"
	 default 1
	 
config MESH_DEVICE_NAME
	string "device name"
	default "light"
config MESH_DEVICE_SOFTWARE_VERSION
	string "device software version"
	default "1.1"
endmenu
```
